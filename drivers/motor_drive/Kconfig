## drivers/motor_drive/Kconfig
```kconfig
# Thao Do

config MOTOR_DRIVE
    bool "Motor Drive"
    default n
    help
      Motor Drive

if MOTOR_DRIVE

config MOTOR_DRIVE_L298
    bool "Motor Drive L298"
    default n
    help
      Motor Drive L298

config MOTOR_DRIVE_DRIVER_INIT_PRIORITY
    int "Driver Initialization Priority"
    default KERNEL_INIT_PRIORITY_DEVICE
    help
      Driver Initialization Priority

endif
```

## drivers/motor_drive_encoder/Kconfig
```kconfig
# Copyright (c) 2024 Thao Do <thaodo2512@gmail.com>
# SPDX-License-Identifier: Apache-2.0

config RPI_PICO_ENCODER
    bool "Raspberry Pi Pico Encoder driver"
    default y
    depends on DT_HAS_THAO_DO_PICO_ENCODER_ENABLED
    select PICOSDK_USE_PIO
```

## dts/bindings/motor_drive/motor-drive.yaml
```yaml
# Copyright (c) 2018, Linaro Limited
# SPDX-License-Identifier: Apache-2.0

description: Motor Drive parent node

compatible: "thao_do,motor-drive"

include: [base.yaml]

properties:
  pwms:
    required: true
    type: phandle-array
    description: |
      Reference to a PWM instance.

  label:
    type: string
    description: |
      PWM NAME

child-binding:
  description: GPIO ENABLE + DIRECTION CONTROL
  properties:
    gpios:
      type: phandle-array
      required: true
    label:
      type: string
      description: |
        GPIO NAME
```

## dts/bindings/motor_drive_encoder/motor-drive-encoder.yaml
```yaml
# Copyright (c) 2024 Thao Do
# SPDX-License-Identifier: Apache-2.0

description: Motor Drive parent node

compatible: "thao_do,pico-encoder"

include: [base.yaml, pinctrl-device.yaml]

properties:
  pulses-per-revolution:
    required: true
    type: int
    description: |
      Resolution of the encoder.

  motor-gear-ratio:
    required: true
    type: int
    description: |
      Gear ratio of the motor.

  motor-default-speed:
    required: true
    type: int
    description: |
      Default speed of the motor when it works in default voltage.

  sampling-time:
    required: true
    type: int
    description: |
      Sampling time of the encoder in us.
```

## motor_control/Kconfig
```kconfig
# Thao Do

config MOTOR_CONTROL
    bool "enable motor control module"
    default n

config MOTOR_CONTROL_PID
    bool "enable PID control"
    default n

config MOTOR_CONTROL_ENCODER
    bool "support to read encoder"
    default n

config MOTOR_CONTROL_USB_COMMUNICATION
    bool "support usb communication"
    default n
```
